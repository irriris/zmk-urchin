## config/west.yml
```yaml
manifest:
  remotes:
    # zmk official
    - name: zmkfirmware
      url-base: https://github.com/zmkfirmware
      # bravekarma
    - name: caksoylar
      url-base: https://github.com/caksoylar
      # kyek / duckyb
    - name: duckyb
      url-base: https://github.com/duckyb
      # nice-view-gem
    - name: m165437
      url-base: https://github.com/M165437
    - name: kot149
      url-base: https://github.com/kot149
  projects:
    - name: zmk
      remote: zmkfirmware
      revision: v0.3.0
      import: app/west.yml
    - name: urchin-zmk-module
      remote: duckyb
      revision: main
    - name: nice-view-gem
      remote: m165437
      revision: v0.3.0
    - name: zmk-layout-shift
      remote: kot149
      revision: v1
  self:
    path: config
```
